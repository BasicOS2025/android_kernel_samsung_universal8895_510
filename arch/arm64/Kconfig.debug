## arch/arm64/Kconfig.debug
```kconfig
# SPDX-License-Identifier: GPL-2.0-only

config PID_IN_CONTEXTIDR
	bool "Write the current PID to the CONTEXTIDR register"
	help
	  Enabling this option causes the kernel to write the current PID to
	  the CONTEXTIDR register, at the expense of some additional
	  instructions during context switch. Say Y here only if you are
	  planning to use hardware trace tools with this kernel.

config DEBUG_EFI
	depends on EFI && DEBUG_INFO
	bool "UEFI debugging"
	help
	  Enable this option to include EFI specific debugging features into
	  the kernel that are only useful when using a debug build of the
	  UEFI firmware

config ARM64_RELOC_TEST
	depends on m
	tristate "Relocation testing module"

config ARM64_EARLY_FB_DEBUG
	bool "Mark early boot progress in the bootloader framebuffer"
	help
	  Paint coloured bands into the framebuffer the bootloader left
	  behind at several points of the primary CPU's early boot path in
	  head.S, which runs with the MMU off. Counting the bands on the
	  screen tells how far the kernel got when it hangs before any
	  console exists. Only for SoC bring-up; say N otherwise.

	  Band 0 (white) is painted on entry to the kernel, band 1 (red)
	  after init_kernel_el, band 2 (green) after the early page tables
	  are built and band 3 (blue) after __cpu_setup, just before the
	  MMU is turned on. Colours may be swapped if the display uses a
	  different channel order.

config ARM64_EARLY_FB_BASE
	hex "Physical base address of the bootloader framebuffer"
	depends on ARM64_EARLY_FB_DEBUG
	default 0xcc000000
	help
	  Must match the framebuffer region of the device tree.

config ARM64_EARLY_FB_STRIDE
	int "Framebuffer stride in bytes"
	depends on ARM64_EARLY_FB_DEBUG
	default 5760
	help
	  Bytes per framebuffer row, 4 bytes per pixel. 5760 is 1440 pixels
	  of the Galaxy S8 panel.

source "drivers/hwtracing/coresight/Kconfig"
```

## arch/arm64/configs/exynos8895_dreamlte_defconfig
```kconfig
CONFIG_EXPERT=y
CONFIG_AUDIT=y
CONFIG_ARCH_EXYNOS=y
CONFIG_SMP=y
CONFIG_NR_CPUS=8
# CONFIG_RANDOMIZE_BASE is not set
CONFIG_CMDLINE="console=tty0 ignore_loglevel clk_ignore_unused initcall_debug log_buf_len=2M"
CONFIG_CMDLINE_EXTEND=y
CONFIG_BLK_DEV_INITRD=y
CONFIG_DEVTMPFS=y
CONFIG_DEVTMPFS_MOUNT=y
CONFIG_IKCONFIG=y
CONFIG_IKCONFIG_PROC=y
CONFIG_MODULES=y
CONFIG_NAMESPACES=y
CONFIG_CGROUPS=y
CONFIG_MEMCG=y
CONFIG_CGROUP_SCHED=y
CONFIG_CGROUP_PIDS=y
CONFIG_CGROUP_FREEZER=y
CONFIG_CGROUP_DEVICE=y
CONFIG_CPUSETS=y
CONFIG_CGROUP_BPF=y
CONFIG_PSI=y
CONFIG_BPF_SYSCALL=y
CONFIG_BPF_JIT=y
CONFIG_BPF_JIT_ALWAYS_ON=y
CONFIG_NET=y
CONFIG_INET=y
CONFIG_IPV6=y
CONFIG_NETFILTER=y
CONFIG_NETFILTER_ADVANCED=y
CONFIG_NETFILTER_XTABLES=y
CONFIG_NETFILTER_XT_MATCH_BPF=y
CONFIG_IP_NF_IPTABLES=y
CONFIG_IP_NF_FILTER=y
CONFIG_IP6_NF_IPTABLES=y
CONFIG_IP6_NF_FILTER=y
CONFIG_NET_SCHED=y
CONFIG_NET_CLS_BPF=y
CONFIG_NET_CLS_ACT=y
CONFIG_NET_ACT_BPF=y
CONFIG_SECCOMP=y
CONFIG_SECCOMP_FILTER=y
CONFIG_TTY=y
CONFIG_VT=y
CONFIG_VT_CONSOLE=y
CONFIG_SERIAL_AMBA_PL011=y
CONFIG_SERIAL_AMBA_PL011_CONSOLE=y
CONFIG_FB=y
CONFIG_FB_SIMPLE=y
CONFIG_FRAMEBUFFER_CONSOLE=y
CONFIG_FONTS=y
CONFIG_FONT_TER16x32=y
CONFIG_EXT4_FS=y
CONFIG_F2FS_FS=y
CONFIG_FS_ENCRYPTION=y
CONFIG_TMPFS=y
CONFIG_PSTORE=y
CONFIG_PSTORE_CONSOLE=y
CONFIG_PSTORE_PMSG=y
CONFIG_PSTORE_RAM=y
CONFIG_SECURITY=y
CONFIG_SECURITY_NETWORK=y
CONFIG_SECURITY_SELINUX=y
CONFIG_ANDROID=y
CONFIG_ANDROID_BINDER_IPC=y
CONFIG_ANDROID_BINDERFS=y
CONFIG_ANDROID_BINDER_DEVICES="binder,hwbinder,vndbinder"
CONFIG_ARM64_EARLY_FB_DEBUG=y
CONFIG_SYNC_FILE=y
CONFIG_DMABUF_HEAPS=y
CONFIG_DMABUF_HEAPS_DEFERRED_FREE=y
CONFIG_DMABUF_HEAPS_PAGE_POOL=y
CONFIG_DMABUF_HEAPS_SYSTEM=y
CONFIG_DMABUF_SYSFS_STATS=y
CONFIG_SCSI=y
CONFIG_BLK_DEV_SD=y
CONFIG_SCSI_UFSHCD=y
CONFIG_SCSI_UFSHCD_PLATFORM=y
CONFIG_SCSI_UFS_EXYNOS=y
CONFIG_PHY_SAMSUNG_UFS=y
CONFIG_REGULATOR=y
CONFIG_EFI_PARTITION=y
CONFIG_CPU_FREQ=y
CONFIG_CPU_FREQ_STAT=y
CONFIG_CPU_FREQ_DEFAULT_GOV_SCHEDUTIL=y
CONFIG_CPU_FREQ_GOV_USERSPACE=y
CONFIG_PM_OPP=y
CONFIG_THERMAL=y
CONFIG_THERMAL_OF=y
CONFIG_CPU_THERMAL=y
CONFIG_CPU_FREQ_THERMAL=y
CONFIG_USB_SUPPORT=y
CONFIG_USB=y
CONFIG_USB_GADGET=y
CONFIG_EXTCON=y
CONFIG_USB_DWC3=y
CONFIG_USB_DWC3_DUAL_ROLE=y
CONFIG_USB_DWC3_EXYNOS=y
CONFIG_USB_CONFIGFS=y
CONFIG_USB_CONFIGFS_F_FS=y
CONFIG_USB_CONFIGFS_UEVENT=y
CONFIG_USB_CONFIGFS_RNDIS=y
CONFIG_DRM=y
CONFIG_DRM_PANFROST=y
CONFIG_WLAN=y
CONFIG_CFG80211=y
CONFIG_PCI=y
CONFIG_BRCMFMAC=y
CONFIG_BRCMFMAC_PCIE=y
CONFIG_BT=y
CONFIG_SERIAL_DEV_BUS=y
CONFIG_BT_HCIUART=y
CONFIG_BT_HCIUART_BCM=y
CONFIG_GPIOLIB=y
CONFIG_FW_LOADER=y
CONFIG_SOUND=y
CONFIG_SND=y
CONFIG_SND_SOC=y
CONFIG_MEDIA_SUPPORT=y
CONFIG_MEDIA_CAMERA_SUPPORT=y
CONFIG_VIDEO_DEV=y
CONFIG_I2C=y
CONFIG_SPI=y
CONFIG_INPUT_EVDEV=y
CONFIG_MMC=y
CONFIG_MMC_DW=y
CONFIG_MMC_DW_EXYNOS=y

CONFIG_SERIAL_SAMSUNG=y
CONFIG_SERIAL_SAMSUNG_CONSOLE=y
```
